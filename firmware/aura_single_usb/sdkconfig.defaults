## firmware/aura_single_usb/sdkconfig.defaults
```kconfig
# 16MB flash + custom partitions
CONFIG_ESPTOOLPY_FLASHSIZE_16MB=y
CONFIG_PARTITION_TABLE_CUSTOM=y
CONFIG_PARTITION_TABLE_CUSTOM_FILENAME="partitions.csv"

# 8MB octal PSRAM (N16R8)
CONFIG_SPIRAM=y
CONFIG_SPIRAM_MODE_OCT=y
CONFIG_SPIRAM_SPEED_80M=y

# Console on UART so the native USB is free for audio
CONFIG_ESP_CONSOLE_UART_DEFAULT=y

# USB audio (verify these in 3.4)
CONFIG_UAC_SAMPLE_RATE=16000
CONFIG_UAC_MIC_CHANNEL_NUM=1
CONFIG_UAC_SPEAKER_CHANNEL_NUM=1
CONFIG_UAC_MIC_INTERVAL_MS=10
CONFIG_UAC_SPK_INTERVAL_MS=10

# Wake word "Hi ESP"
CONFIG_SR_WN_WN9_HIESP=y

# Performance
CONFIG_ESP_DEFAULT_CPU_FREQ_MHZ_240=y
CONFIG_FREERTOS_HZ=1000
```
